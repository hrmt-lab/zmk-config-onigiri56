## config/boards/shields/onigiri56/Kconfig.defconfig
```kconfig
if SHIELD_ONIGIRI56_LEFT
config ZMK_KEYBOARD_NAME
    default "onigiri56"

config ZMK_SPLIT_ROLE_CENTRAL
    default y
endif

if SHIELD_ONIGIRI56_LEFT || SHIELD_ONIGIRI56_RIGHT
config NFCT_PINS_AS_GPIOS
    default y

config ZMK_SPLIT
    default y
endif
```

## config/boards/shields/onigiri56/Kconfig.shield
```kconfig
config SHIELD_ONIGIRI56_LEFT
    def_bool $(shields_list_contains,onigiri56_left)

config SHIELD_ONIGIRI56_RIGHT
    def_bool $(shields_list_contains,onigiri56_right)
```

## config/west.yml
```yaml
manifest:
  remotes:
    - name: zmkfirmware
      url-base: https://github.com/zmkfirmware
    - name: hrmt-lab
      url-base: https://github.com/hrmt-lab
  projects:
    - name: zmk
      remote: zmkfirmware
      revision: main
      import: app/west.yml
  self:
    path: config
```
